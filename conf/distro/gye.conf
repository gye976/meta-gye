## conf/distro/gye.conf
```bitbake
require conf/distro/poky.conf

DISTRO = "gye"
DISTRO_NAME = "gye custom distro"
DISTRO_VERSION = "1.0"

INIT_MANAGER = "systemd"

LICENSE_FLAGS_ACCEPTED = "synaptics-killswitch"
```

## conf/layer.conf
```bitbake
# We have a conf and classes directory, add to BBPATH
BBPATH .= ":${LAYERDIR}"

# We have recipes-* directories, add to BBFILES
BBFILES += "${LAYERDIR}/recipes-*/*/*.bb \
            ${LAYERDIR}/recipes-*/*/*/*.bb \
            ${LAYERDIR}/recipes-*/*/*.bbappend \
            "

BBFILE_COLLECTIONS += "meta-gye"
BBFILE_PATTERN_meta-gye = "^${LAYERDIR}/"
BBFILE_PRIORITY_meta-gye = "6"

LAYERDEPENDS_meta-gye = "core qt6-layer"
LAYERSERIES_COMPAT_meta-gye = "scarthgap"
```
